## sdkconfig.defaults
```kconfig
# Rust often needs a bit of an extra main task stack size compared to C (the default is 3K)
CONFIG_ESP_MAIN_TASK_STACK_SIZE= 8000

#disabling the watchdogs until i understand more
#https://github.com/esp-rs/esp-idf-hal/issues/124
CONFIG_ESP_TASK_WDT_EN=n
#increase the watchdog timer so mostly idle tasks don't make the dog angry
#CONFIG_ESP_TASK_WDT_TIMEOUT_S=5
# Use this to set FreeRTOS kernel tick frequency to 1000 Hz (100 Hz by default).
# This allows to use 1 ms granuality for thread sleeps (10 ms by default).
#CONFIG_FREERTOS_HZ=1000

# Workaround for https://github.com/espressif/esp-idf/issues/7631
#CONFIG_MBEDTLS_CERTIFICATE_BUNDLE=n
#CONFIG_MBEDTLS_CERTIFICATE_BUNDLE_DEFAULT_FULL=n
```
